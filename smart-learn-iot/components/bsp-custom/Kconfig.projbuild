## smart-learn-iot/components/bsp-custom/Kconfig.projbuild
```kconfig
menu "Custom ESP32-S3 Board"

    config BOARD_I2C_SDA_GPIO
        int "I2C SDA GPIO (OLED)"
        default 17

    config BOARD_I2C_SCL_GPIO
        int "I2C SCL GPIO (OLED)"
        default 18

    config BOARD_OLED_I2C_ADDR
        hex "SH1106 I2C address"
        default 0x3C

    config BOARD_I2S_MIC_BCLK_GPIO
        int "INMP441 BCLK GPIO"
        default 4

    config BOARD_I2S_MIC_WS_GPIO
        int "INMP441 WS/LRC GPIO"
        default 5

    config BOARD_I2S_MIC_DIN_GPIO
        int "INMP441 DOUT GPIO"
        default 6

    config BOARD_I2S_SPK_BCLK_GPIO
        int "MAX98357 BCLK GPIO"
        default 15

    config BOARD_I2S_SPK_WS_GPIO
        int "MAX98357 LRC GPIO"
        default 16

    config BOARD_I2S_SPK_DOUT_GPIO
        int "MAX98357 DIN GPIO"
        default 7

    config BOARD_RFID_SPI_HOST
        int "RC522 SPI host (SPI2_HOST=1, SPI3_HOST=2)"
        default 1

    config BOARD_RFID_CS_GPIO
        int "RC522 CS/SDA GPIO"
        default 10

    config BOARD_RFID_RST_GPIO
        int "RC522 RST GPIO"
        default 14

    config BOARD_RFID_MOSI_GPIO
        int "RC522 MOSI GPIO"
        default 11

    config BOARD_RFID_MISO_GPIO
        int "RC522 MISO GPIO"
        default 13

    config BOARD_RFID_SCK_GPIO
        int "RC522 SCK GPIO"
        default 12

endmenu
```

## smart-learn-iot/smart-learn-board/main/Kconfig.projbuild
```kconfig
menu "Example Configuration"

    config VOLUME_LEVEL
        int "volume level"
        default "90"
        range 1 100

    config MAX_TOKEN
        int "Chat GPT Response Token"
        default 500
        range 1 2048

    choice TTS_VOICE_SELECTION
        prompt "TTS Voice Selection"
        default TTS_VOICE_SHIMMER

        config TTS_VOICE_ALLOY
            bool "alloy (male)"
        config TTS_VOICE_ECHO
            bool "echo (male)"
        config TTS_VOICE_ONYX
            bool "onyx (male)"
        config TTS_VOICE_FABLE
            bool "fable (female)"
        config TTS_VOICE_NOVA
            bool "nova (female)"
        config TTS_VOICE_SHIMMER
            bool "shimmer (female)"
    endchoice

    config TTS_VOICE
        string
        default "alloy" if TTS_VOICE_ALLOY
        default "echo" if TTS_VOICE_ECHO
        default "onyx" if TTS_VOICE_ONYX
        default "fable" if TTS_VOICE_FABLE
        default "nova" if TTS_VOICE_NOVA
        default "shimmer" if TTS_VOICE_SHIMMER

    config ESP_MAXIMUM_RETRY
        int "Maximum retry"
        default 5

    choice ESP_WIFI_SCAN_AUTH_MODE_THRESHOLD
        prompt "WiFi Scan auth mode threshold"
        default ESP_WIFI_AUTH_WPA2_PSK

        config ESP_WIFI_AUTH_OPEN
            bool "OPEN"
        config ESP_WIFI_AUTH_WEP
            bool "WEP"
        config ESP_WIFI_AUTH_WPA_PSK
            bool "WPA PSK"
        config ESP_WIFI_AUTH_WPA2_PSK
            bool "WPA2 PSK"
        config ESP_WIFI_AUTH_WPA_WPA2_PSK
            bool "WPA/WPA2 PSK"
        config ESP_WIFI_AUTH_WPA3_PSK
            bool "WPA3 PSK"
        config ESP_WIFI_AUTH_WPA2_WPA3_PSK
            bool "WPA2/WPA3 PSK"
        config ESP_WIFI_AUTH_WAPI_PSK
            bool "WAPI PSK"
    endchoice

endmenu
```

## smart-learn-iot/smart-learn-board/sdkconfig.defaults
```kconfig
CONFIG_IDF_TARGET="esp32s3"
CONFIG_ESPTOOLPY_FLASHMODE_QIO=y
CONFIG_ESPTOOLPY_FLASHSIZE_16MB=y
CONFIG_PARTITION_TABLE_CUSTOM=y
CONFIG_SR_WN_WN9_HIESP=y
CONFIG_SR_MN_CN_NONE=y
CONFIG_SR_MN_EN_MULTINET5_SINGLE_RECOGNITION_QUANT8=y
CONFIG_EN_SPEECH_COMMAND_ID0="STnP"
CONFIG_COMPILER_OPTIMIZATION_PERF=y
CONFIG_SPIRAM=y
CONFIG_SPIRAM_MODE_OCT=y
CONFIG_SPIRAM_FETCH_INSTRUCTIONS=y
CONFIG_SPIRAM_MALLOC_ALWAYSINTERNAL=1024
CONFIG_SPIRAM_TRY_ALLOCATE_WIFI_LWIP=y
CONFIG_SPIRAM_MALLOC_RESERVE_INTERNAL=8192
CONFIG_ESP_DEFAULT_CPU_FREQ_MHZ_240=y
CONFIG_ESP32S3_DATA_CACHE_64KB=y
CONFIG_ESP32S3_DATA_CACHE_LINE_64B=y
CONFIG_ESP_WIFI_STATIC_RX_BUFFER_NUM=10
CONFIG_ESP_WIFI_RX_BA_WIN=6
CONFIG_FREERTOS_HZ=1000
CONFIG_MBEDTLS_DYNAMIC_BUFFER=y
CONFIG_MBEDTLS_DYNAMIC_FREE_CONFIG_DATA=y
CONFIG_IDF_EXPERIMENTAL_FEATURES=y
CONFIG_SPIRAM_SPEED_80M=y
CONFIG_SPIRAM_SPEED=80
CONFIG_ESPTOOLPY_FLASHFREQ_80M=y
CONFIG_ESPTOOLPY_FLASHFREQ="80m"
CONFIG_MODEL_IN_SPIFFS=y
CONFIG_BOARD_I2C_SDA_GPIO=17
CONFIG_BOARD_I2C_SCL_GPIO=18
```
