#include <string.h>
#include <stdio.h>
#include "driver/i2c_master.h"
#include "esp_log.h"
#include "esp_check.h"
#include "sdkconfig.h"
#include "bsp_oled.h"

extern i2c_master_bus_handle_t bsp_i2c_get_bus(void);

static const char *TAG = "bsp_oled";

static i2c_master_dev_handle_t s_oled_dev;
static uint8_t s_framebuffer[BSP_OLED_WIDTH * BSP_OLED_HEIGHT / 8];
static char s_lines[8][22];
static char s_title[22];

static const uint8_t font6x8[][6] = {
    {0x00,0x00,0x00,0x00,0x00,0x00},
    {0x00,0x00,0x5F,0x00,0x00,0x00},
    {0x00,0x07,0x00,0x07,0x00,0x00},
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    {0x44,0x64,0x54,0x4C,0x44,0x00},
};

static esp_err_t oled_write_cmd(uint8_t cmd)
{
    uint8_t buf[2] = {0x00, cmd};
    return i2c_master_transmit(s_oled_dev, buf, sizeof(buf), 1000);
}

static esp_err_t oled_write_data(const uint8_t *data, size_t len)
{
    uint8_t stack[17];
    while (len > 0) {
        size_t chunk = len > 16 ? 16 : len;
        stack[0] = 0x40;
        memcpy(&stack[1], data, chunk);
        ESP_RETURN_ON_ERROR(i2c_master_transmit(s_oled_dev, stack, chunk + 1, 1000), TAG, "data");
        data += chunk;
        len -= chunk;
    }
    return ESP_OK;
}

static void draw_char(int x, int y, char c)
{
    if (c < 32 || c > 126) {
        c = '?';
    }
    const uint8_t *glyph = font6x8[c - 32];
    for (int col = 0; col < 6; col++) {
        uint8_t line = glyph[col];
        for (int row = 0; row < 8; row++) {
            if (line & (1 << row)) {
                int px = x + col;
                int py = y + row;
                if (px >= 0 && px < BSP_OLED_WIDTH && py >= 0 && py < BSP_OLED_HEIGHT) {
                    s_framebuffer[px + (py / 8) * BSP_OLED_WIDTH] |= (1 << (py % 8));
                }
            }
        }
    }
}

static void render_text_to_fb(void)
{
    memset(s_framebuffer, 0, sizeof(s_framebuffer));

    int y = 0;
    draw_char(0, y, '>');
    for (int i = 0; s_title[i] && i < 20; i++) {
        draw_char(8 + i * 6, y, s_title[i]);
    }

    for (int line = 0; line < 7; line++) {
        y = 8 + line * 8;
        for (int i = 0; s_lines[line][i]; i++) {
            draw_char(i * 6, y, s_lines[line][i]);
        }
    }
}

esp_err_t bsp_oled_init(void)
{
    i2c_master_bus_handle_t bus = bsp_i2c_get_bus();
    if (!bus) {
        return ESP_ERR_INVALID_STATE;
    }

    i2c_device_config_t dev_cfg = {
        .dev_addr_length = I2C_ADDR_BIT_LEN_7,
        .device_address = CONFIG_BOARD_OLED_I2C_ADDR,
        .scl_speed_hz = 400000,
    };
    ESP_RETURN_ON_ERROR(i2c_master_bus_add_device(bus, &dev_cfg, &s_oled_dev), TAG, "add dev");

    const uint8_t init_seq[] = {
        0xAE, 0xD5, 0x80, 0xA8, 0x3F, 0xD3, 0x00, 0x40, 0x8D, 0x14,
        0x20, 0x00, 0xA1, 0xC8, 0xDA, 0x12, 0x81, 0xCF, 0xD9, 0xF1,
        0xDB, 0x40, 0xA4, 0xA6, 0xAF
    };

    for (size_t i = 0; i < sizeof(init_seq); i++) {
        ESP_RETURN_ON_ERROR(oled_write_cmd(init_seq[i]), TAG, "init");
    }

    strcpy(s_title, "Smart Learn");
    for (int i = 0; i < 7; i++) {
        s_lines[i][0] = '\0';
    }
    bsp_oled_clear();
    ESP_LOGI(TAG, "SH1106 OLED ready");
    return ESP_OK;
}

void bsp_oled_clear(void)
{
    for (int i = 0; i < 7; i++) {
        s_lines[i][0] = '\0';
    }
    render_text_to_fb();
    bsp_oled_display();
}

void bsp_oled_set_title(const char *text)
{
    if (!text) {
        return;
    }
    snprintf(s_title, sizeof(s_title), "%s", text);
}

void bsp_oled_set_line(uint8_t line, const char *text)
{
    if (line >= 7 || !text) {
        return;
    }
    snprintf(s_lines[line], sizeof(s_lines[0]), "%s", text);
}

static void wrap_text_to_lines(const char *text)
{
    for (int i = 0; i < 7; i++) {
        s_lines[i][0] = '\0';
    }
    if (!text) {
        return;
    }

    int line = 0;
    int col = 0;
    for (size_t i = 0; text[i] && line < 7; i++) {
        if (text[i] == '\n' || col >= 21) {
            line++;
            col = 0;
            if (text[i] == '\n') {
                continue;
            }
        }
        s_lines[line][col++] = text[i];
        s_lines[line][col] = '\0';
    }
}

void bsp_oled_set_body(const char *text)
{
    wrap_text_to_lines(text);
}

void bsp_oled_display(void)
{
    render_text_to_fb();

    for (uint8_t page = 0; page < 8; page++) {
        oled_write_cmd(0xB0 + page);
        oled_write_cmd(0x02);
        oled_write_cmd(0x10);
        oled_write_data(&s_framebuffer[page * BSP_OLED_WIDTH], BSP_OLED_WIDTH);
    }
}
